## boards/seeed/xiao_esp32s3/board.yml
```yaml
board:
  name: xiao_esp32s3
  full_name: XIAO ESP32S3
  vendor: seeed
  socs: 
  - name: esp32s3
    variants:
    - name: appcpu
      cpucluster: appcpu
    - name: procpu
      cpucluster: procpu
    - name: sense
      cpucluster: procpu
```
